## main/Kconfig.projbuild
```kconfig
menu "T2V Module"

choice T2V_PRESET
    prompt "T2V Preset"

    config T2V_PRESET_NONE
        bool "None"

    config T2V_REFERENCE_RECEIVER
        bool "Reference Receiver"
        select T2V_BLE_ENABLE
        select T2V_IR_NEC_RX_ENABLE
        select T2V_USE_PCB
        select T2V_USB_DEVICE_ENABLE

    config T2V_REFERENCE_SENDER
        bool "Reference Sender"
        select T2V_ZENOH_ENABLE
        select T2V_IR_NEC_TX_ENABLE
        select T2V_USE_PCB

endchoice

config T2V_USE_PCB
    bool "Use reference PCB"
    default y

menu "Capabilities"

config T2V_CAP_SEND_IR_FRAMES
    bool "Capability: Send IR Frames"
    depends on T2V_ZENOH_ENABLE && T2V_IR_NEC_TX_ENABLE
    default y

config T2V_CAP_START_LIGHTS
    bool "Capability: Start Lights"
    depends on T2V_ZENOH_ENABLE && T2V_WS2812_ENABLE
    default y

endmenu


config T2V_NVS_NAMESPACE
    string "NVS Namespace"
    default "t2v_module"

menuconfig T2V_ADDRESS_CONFIG_ENABLE
    bool "Store Address Config"
    default y

if T2V_ADDRESS_CONFIG_ENABLE

    config T2V_ADDRESS_CONFIG_NVS_KEY
        string "NVS Storage Key"
        default "address_config"
endif

menu "Tasks"

rsource "ble_task/Kconfig.ble_task"
rsource "btn_input_task/Kconfig.btn_input_task"
rsource "ethernet_task/Kconfig.ethernet_task"
rsource "ir_nec_rx_task/Kconfig.ir_nec_rx_task"
rsource "ir_nec_tx_task/Kconfig.ir_nec_tx_task"
rsource "led_driver_task/Kconfig.led_driver_task"
rsource "usb_device_task/Kconfig.usb_device_task"
rsource "ws2812_task/Kconfig.ws2812_task"
rsource "zenoh_task/Kconfig.zenoh_task"

endmenu

menu "Drivers"

    config T2V_RMT_FREQUENCY
        int "RMT Frequency [Hz]"
        default 1000000

endmenu



endmenu # T2V Module
```

## main/ble_task/Kconfig.ble_task
```kconfig
menuconfig T2V_BLE_ENABLE
    bool "BLE Task"
    default y if T2V_REFERENCE_RECEIVER
    select T2V_ADDRESS_CONFIG_ENABLE

if T2V_BLE_ENABLE

    config T2V_BLE_ADV_NAME
        string "Device Name (BLE Adv.)"

    config T2V_BLE_CAR_ID
        string "Car ID"

    config T2V_BLE_TEAM_NAME
        string "Team Name"

endif
```

## main/btn_input_task/Kconfig.btn_input_task
```kconfig
menuconfig T2V_BTN_INPUT_ENABLE
    bool "Button Input Task"
    default y if T2V_REFERENCE_SENDER

if T2V_BTN_INPUT_ENABLE

    choice T2V_BTN_INPUT_SW1_GPIO
        prompt "SW1 GPIO"
        depends on T2V_USE_PCB

        config T2V_BTN_INPUT_SW1_GPIO_32
            bool "GPIO 32"

    endchoice

    config T2V_BTN_INPUT_SW1_GPIO_NUM
        int
        prompt "SW1 GPIO" if !T2V_USE_PCB
        default 32 if T2V_BTN_INPUT_SW1_GPIO_32

    choice T2V_BTN_INPUT_SW2_GPIO
        prompt "SW2 GPIO"
        depends on T2V_USE_PCB

        config T2V_BTN_INPUT_SW2_GPIO_33
            bool "GPIO 33"

    endchoice

    config T2V_BTN_INPUT_SW2_GPIO_NUM
        int
        prompt "SW2 GPIO" if !T2V_USE_PCB
        default 33 if T2V_BTN_INPUT_SW2_GPIO_33

endif
```

## main/ethernet_task/Kconfig.ethernet_task
```kconfig
config T2V_ETHERNET_ENABLE
    bool "Ethernet Task"
    default y if T2V_REFERENCE_SENDER
```

## main/ir_nec_rx_task/Kconfig.ir_nec_rx_task
```kconfig
menuconfig T2V_IR_NEC_RX_ENABLE
    bool "IR NEC Receiver Task"
    default y if T2V_REFERENCE_RECEIVER
    select T2V_ADDRESS_CONFIG_ENABLE

if T2V_IR_NEC_RX_ENABLE

    choice T2V_IR_NEC_RX_GPIO
        prompt "GPIO"
        depends on T2V_USE_PCB

        config T2V_IR_NEC_RX_GPIO_20
             bool "GPIO 20"

    endchoice

    config T2V_IR_NEC_RX_GPIO_NUM
        int
        prompt "GPIO" if !T2V_USE_PCB
        default 20 if T2V_IR_NEC_RX_GPIO_20

endif
```

## main/ir_nec_tx_task/Kconfig.ir_nec_tx_task
```kconfig
menuconfig T2V_IR_NEC_TX_ENABLE
    bool "IR NEC Sender Task"
    default y if T2V_REFERENCE_SENDER

if T2V_IR_NEC_TX_ENABLE

choice T2V_IR_NEC_TX_GPIO
    prompt "GPIO"
    depends on T2V_USE_PCB

    config T2V_IR_NEC_TX_GPIO_23
        bool "GPIO 23 (J9_3/J9_4/D2)"

    config T2V_IR_NEC_TX_GPIO_07
        bool "GPIO 7 (J10_3)"
endchoice

config T2V_IR_NEC_TX_GPIO_NUM
    int
    prompt "GPIO" if !T2V_USE_PCB
    default 7 if T2V_IR_NEC_TX_GPIO_07
    default 23 if T2V_IR_NEC_TX_GPIO_23

endif
```

## main/led_driver_task/Kconfig.led_driver_task
```kconfig
menuconfig T2V_LED_DRIVER_ENABLE
    bool "LED Driver Task"
    default y if T2V_REFERENCE_RECEIVER || T2V_REFERENCE_SENDER

if T2V_LED_DRIVER_ENABLE

    choice T2V_LED_DRIVER_SDI_GPIO
        prompt "SDI GPIO"
        depends on T2V_USE_PCB

        config T2V_LED_DRIVER_SDI_GPIO_25
            bool "GPIO 25"

    endchoice

    config T2V_LED_DRIVER_SDI_GPIO_NUM
        int
        prompt "SDI GPIO" if !T2V_USE_PCB
        default 25 if T2V_LED_DRIVER_SDI_GPIO_25

    choice T2V_LED_DRIVER_CLK_GPIO
        prompt "CLK GPIO"
        depends on T2V_USE_PCB

        config T2V_LED_DRIVER_CLK_GPIO_24
            bool "GPIO 24"

    endchoice

    config T2V_LED_DRIVER_CLK_GPIO_NUM
        int
        prompt "CLK GPIO" if !T2V_USE_PCB
        default 24 if T2V_LED_DRIVER_CLK_GPIO_24

    choice T2V_LED_DRIVER_LE_GPIO
        prompt "LE GPIO"
        depends on T2V_USE_PCB

        config T2V_LED_DRIVER_LE_GPIO_21
            bool "GPIO 21"

    endchoice

    config T2V_LED_DRIVER_LE_GPIO_NUM
        int
        prompt "LE GPIO" if !T2V_USE_PCB
        default 21 if T2V_LED_DRIVER_LE_GPIO_21

    choice T2V_LED_DRIVER_OE_GPIO
        prompt "OE GPIO"
        depends on T2V_USE_PCB

        config T2V_LED_DRIVER_OE_GPIO_22
            bool "GPIO 22"

    endchoice

    config T2V_LED_DRIVER_OE_GPIO_NUM
        int
        prompt "OE GPIO" if !T2V_USE_PCB
        default 22 if T2V_LED_DRIVER_OE_GPIO_22


endif
```

## main/usb_device_task/Kconfig.usb_device_task
```kconfig
config T2V_USB_DEVICE_ENABLE
    bool "USB Device Task"
    default y if T2V_REFERENCE_RECEIVER
    select T2V_IR_NEC_RX_ENABLE
```

## main/ws2812_task/Kconfig.ws2812_task
```kconfig
menuconfig T2V_WS2812_ENABLE
    bool "WS2812 Task"

if T2V_WS2812_ENABLE

    choice T2V_WS2812_GPIO
        prompt "GPIO"
        depends on T2V_USE_PCB

        config T2V_WS2812_GPIO_07
            bool "GPIO 7 (J10_3)"
    endchoice

    config T2V_WS2812_GPIO_NUM
        int
        prompt "GPIO" if !T2V_USE_PCB
        default 7 if T2V_WS2812_GPIO_07

    config T2V_WS2812_RMT_FREQUENCY
        int "RMT Frequency"
        default 10000000

    config T2V_WS2812_LED_COUNT
        int "LED Count"
        default 40

endif
```

## main/zenoh_task/Kconfig.zenoh_task
```kconfig
menuconfig T2V_ZENOH_ENABLE
    bool "Zenoh Task"
    default y if T2V_REFERENCE_SENDER
    select T2V_ETHERNET_ENABLE

if T2V_ZENOH_ENABLE
    choice T2V_ZENOH_ROUTER_LOCATOR_PROTOCOL
        prompt "Router Protocol"

        config T2V_ZENOH_ROUTER_LOCATOR_PROTOCOL_TCP
            bool "tcp"

        config T2V_ZENOH_ROUTER_LOCATOR_PROTOCOL_UDP
            bool "udp"
    endchoice

    config T2V_ZENOH_ROUTER_LOCATOR_HOST
        string
        prompt "Router Host"
        help
            Hostname or IP address of the router

    config T2V_ZENOH_ROUTER_LOCATOR_PORT
        int
        prompt "Router Port"
        help
            Port of the router
        default 7447

    config T2V_ZENOH_BASE_KEYEXPR
        string
        prompt "Base Key Expression"
        default "services/t2v"
        help
            Base key expression used to derive other key expressions

endif
```

## sdkconfig.defaults
```kconfig
#
# BT config
# - ESP32 co-processor only supports BLE 4.2
#
CONFIG_BT_ENABLED=y
CONFIG_BT_CONTROLLER_DISABLED=y
CONFIG_BT_BLUEDROID_ENABLED=y
CONFIG_BT_BLE_50_FEATURES_SUPPORTED=n
CONFIG_BT_BLE_42_FEATURES_SUPPORTED=y
# CONFIG_BT_LE_50_FEATURE_SUPPORT is not used on ESP32, ESP32-C3 and ESP32-S3.

#
# Wi-Fi Remote
#
CONFIG_ESP_WIFI_REMOTE_LIBRARY_HOSTED=y

#
# Enable ESP Hosted BT
# Used as VHCI transport between BT Host and Controller
#
CONFIG_ESP_HOSTED_ENABLE_BT_BLUEDROID=y
CONFIG_ESP_HOSTED_BLUEDROID_HCI_VHCI=y

#
# Configure large enough partition table
#
CONFIG_PARTITION_TABLE_CUSTOM_FILENAME="partitions.csv"
CONFIG_PARTITION_TABLE_FILENAME="partitions_singleapp_large.csv"
CONFIG_PARTITION_TABLE_OFFSET=0x8000
CONFIG_PARTITION_TABLE_MD5=y

#
# Configure hardware setting for Waveshare ESP32P4-Nano
#
CONFIG_SPI_FLASH_SUPPORT_GD_CHIP=y
CONFIG_ESPTOOLPY_FLASHSIZE_16MB=y
```
